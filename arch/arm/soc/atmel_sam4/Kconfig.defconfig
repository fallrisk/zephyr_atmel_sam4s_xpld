## arch/arm/soc/atmel_sam4/Kconfig.defconfig
```kconfig
# Kconfig - Atmel SAM4 family processor configuration options

#
# Copyright (c) 2016 Intel Corporation.
# Copyright (c) 2014-2015 Wind River Systems, Inc.
#
# Licensed under the Apache License, Version 2.0 (the "License");
# you may not use this file except in compliance with the License.
# You may obtain a copy of the License at
#
#     http://www.apache.org/licenses/LICENSE-2.0
#
# Unless required by applicable law or agreed to in writing, software
# distributed under the License is distributed on an "AS IS" BASIS,
# WITHOUT WARRANTIES OR CONDITIONS OF ANY KIND, either express or implied.
# See the License for the specific language governing permissions and
# limitations under the License.
#

if SOC_ATMEL_SAM4

config SOC
	default atmel_sam4

config NUM_IRQ_PRIO_BITS
	int
	default 4

#
# SAM4S16 has total 35 peripherals capable of
# generating interrupts.
#
config NUM_IRQS
	int
	default 35

config SYS_CLOCK_HW_CYCLES_PER_SEC
	int
	default 84000000

#
# SRAM address depends on the processor.
#
# SAM4S16 has 1 SRAM bank:
#   1024K @ 0x20100000
#
# Table 8-1 of datasheet has the SRAM Size
# Figure 7-1 page 38 has the SRAM base address
#
config SRAM_SIZE
	default 128 if SOC_ATMEL_SAM4S16

config SRAM_BASE_ADDRESS
	default 0x20100000 if SOC_ATMEL_SAM4S16

#
# Atmel SAM4 family has flash starting @ 0x00080000.
#
# SAM4S16 has 1024K of flash.
#
config FLASH_SIZE
	default 1024 if SOC_ATMEL_SAM4S16

config FLASH_BASE_ADDRESS
	default 0x00400000

if UART_ATMEL_SAM4

config UART_ATMEL_SAM4_BAUD_RATE
	default 115200

config UART_ATMEL_SAM4_CLK_FREQ
	default 84000000

endif # UART_ATMEL_SAM4

if GPIO

config GPIO_ATMEL_SAM4
	def_bool y

config GPIO_ATMEL_SAM4_PORTA
	default y

config GPIO_ATMEL_SAM4_PORTB
	default y

config GPIO_ATMEL_SAM4_PORTC
	default y

endif # GPIO

endif # SOC_ATMEL_SAM4
```

## arch/arm/soc/atmel_sam4/Kconfig.soc
```kconfig
config SOC_ATMEL_SAM4S16
	bool "Atmel SAM4S16 Processor"
	select CPU_CORTEX_M
	select CPU_CORTEX_M4
	select SOC_ATMEL_SAM3
	select SYS_POWER_LOW_POWER_STATE_SUPPORTED
```

## boards/atmel_sam4s_xpld/Kconfig.board
```kconfig
config BOARD_ATMEL_SAM4S_XPLD
	bool "Atmel SAM4S Xplained"
	depends on SOC_ATMEL_SAM4S16
```

## boards/atmel_sam4s_xpld/Kconfig.defconfig
```kconfig
if BOARD_ATMEL_SAM4S_XPLD

config BOARD
	default atmel_sam4s_xplained

endif # BOARD_ATMEL_SAM4S_XPLD
```
